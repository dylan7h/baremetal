## configs/realview-pb-a8_defconfig
```kconfig
CONFIG_CROSS_COMPILE=tools/toolchain/arm-none-eabi/bin/arm-none-eabi-
CONFIG_CPU_ARMV7_A=y
CONFIG_INSTRUCTION_SET=A32
CONFIG_LIB_C=y
CONFIG_PLAT_ARM=y
CONFIG_REALVIEW_PB_A8=y
CONFIG_APP_TEMPLATE=y
CONFIG_SYS_TEXT_BASE=0x000000
CONFIG_OUTPUT_DIR=output
CONFIG_DEBUG_BUILD=y
CONFIG_OPTIMIZE_LEVEL=0
CONFIG_VERBOSE=n
```
